## Kconfig
```kconfig
rsource "afb-binding/zephyr/Kconfig"
rsource "rp-lib-utils/zephyr/Kconfig"
rsource "afb-libafb/zephyr/Kconfig"

config AFB_ZEPHYR
	bool "AFB Support"
	help
	  This option enables the Application Framework Binder library module

config AFB_ZEPHYR_NET
	bool "AFB net capabilities"
	depends on AFB_ZEPHYR
	select NETWORKING
	help
	  This option enables AFB zephyr module net capabilities

choice AFB_ZEPHYR_RPC_BACKEND
	prompt "AFB RPC communication"
    default AFB_ZEPHYR_RPC_NET
	depends on AFB_ZEPHYR
config AFB_ZEPHYR_RPC_NET
	bool "AFB RPC over TCP/IP capabilities"
	depends on AFB_ZEPHYR_NET
	help
		This option enable AFB Binder RPC over TCP/IP.
		It allows communicating with a binding that is
		only reachable on the network.
endchoice

config AFB_ZEPHYR_LLEXT_LOADER
	bool "AFB support loading LLEXT bindings"
	depends on AFB_ZEPHYR
	help
		Add support for using LLEXT to load Zephyr
		bindings

config AFB_ZEPHYR_LLEXT_BINDING
	bool "AFB loadable binding with LLEXT"
	depends on !AFB_ZEPHYR
	help
		When creating a zephyr binding loaded by LLEXT.

config AFB_ZEPHYR_MBEDTLS
	bool "Allow use of TLS features of AFB"
	depends on AFB_ZEPHYR
	depends on AFB_ZEPHYR_NET
	help
		Add support for TLS using MBEDTLS


rsource "configs/Kconfig.main"
rsource "configs/Kconfig.net"
rsource "configs/Kconfig.llext"
rsource "configs/Kconfig.tls"
```

## configs/Kconfig.llext
```kconfig
if AFB_ZEPHYR_LLEXT_LOADER
    config LLEXT
        default y
    config LLEXT_HEAP_SIZE
        default 32
    choice LLEXT_BINARY_TYPE
        default LLEXT_TYPE_ELF_RELOCATABLE
    endchoice # LLEXT_BINARY_TYPE
    choice LLEXT_LOG_LEVEL_CHOICE
        default LLEXT_LOG_LEVEL_WRN
    endchoice # LLEXT_LOG_LEVEL_CHOICE
endif # AFB_ZEPHYR_LLEXT_LOADER

if AFB_ZEPHYR_LLEXT_BINDING
    config LLEXT
        default y
    config LLEXT_HEAP_SIZE
        default 32
    choice LLEXT_BINARY_TYPE
        default LLEXT_TYPE_ELF_RELOCATABLE
    endchoice # LLEXT_BINARY_TYPE
    config LLEXT_EDK_NAME
        default "afb-sdk"
    config APPLICATION_DEFINED_SYSCALL
        default y
endif # AFB_ZEPHYR_LLEXT_BINDING
```

## configs/Kconfig.main
```kconfig
if AFB_ZEPHYR
    config POSIX_API
        default y
    # Threading
    #config PTHREAD_IPC
    config POSIX_THREADS
        default y
    config THREAD_STACK_INFO
        default y
    config DYNAMIC_THREAD
        default y
    config DYNAMIC_THREAD_ALLOC
        default y
    choice DYNAMIC_THREAD_PREFER
        default DYNAMIC_THREAD_PREFER_ALLOC
    endchoice # DYNAMIC_THREAD_PREFER
    config DYNAMIC_THREAD_POOL_SIZE
        default 4
    config DYNAMIC_THREAD_STACK_SIZE
        default 2048
    config LOG_BLOCK_IN_THREAD
        default y
    config LOG_BLOCK_IN_THREAD_TIMEOUT_MS
        default 1000

    # ZVFS (Zephyr virtual filesystem)
    config ZVFS_OPEN_MAX
        default 20
    config ZVFS
        default y
    config ZVFS_EVENTFD
        default y
    config ZVFS_EVENTFD_MAX
        default 4

    # Stacks
    config MAIN_STACK_SIZE
        default 4096
    config INIT_STACKS
        default y

    # Logging
    config LOG
        default y
endif # AFB_ZEPHYR
```

## configs/Kconfig.net
```kconfig
if AFB_ZEPHYR_NET
    config NET_IPV6
        default n
    config NET_IPV4
        default y
    config NET_ARP
        default y
    config NET_UDP
        default y
    config NET_TCP
        default y
    config NET_DHCPV4
        default y
    config NET_DHCPV4_OPTION_CALLBACKS
        default y
    config DNS_RESOLVER
        default y
    config NET_IPV4_AUTO
        default n

    config NET_PKT_RX_COUNT
        default 16
    config NET_PKT_TX_COUNT
        default 16
    config NET_BUF_RX_COUNT
        default 80
    config NET_BUF_TX_COUNT
        default 80

    config NET_L2_ETHERNET
        default y
    config NET_SOCKETS
        default y
    config NET_SOCKETS_SERVICE_THREAD_PRIO
        default -1
    config NET_SOCKETS_POLL_MAX
        default 20

    config NET_MGMT
        default y
    config NET_MGMT_EVENT
        default y

    config NET_LOG
        default y

    config NET_HOSTNAME_ENABLE
        default y
    config NET_HOSTNAME
        default "zefpesk"

    config NET_MAX_CONN
        default 10
    config NET_MAX_CONTEXTS
        default 10
endif # AFB_ZEPHYR_NET
```

## configs/Kconfig.tls
```kconfig
if AFB_ZEPHYR_MBEDTLS
    config MBEDTLS
        default y
    choice MBEDTLS_IMPLEMENTATION
        default MBEDTLS_BUILTIN
    endchoice
    config MBEDTLS_DEBUG
        default y
    config MBEDTLS_ENABLE_HEAP
        default y
    config MBEDTLS_SSL_MAX_CONTENT_LEN
        default 2048
    config NET_SOCKETS_SOCKOPT_TLS
        default y
    config NET_SOCKETS_TLS_MAX_CONTEXTS
        default 6

    config MBEDTLS_ECDSA_C
        default y
    config MBEDTLS_ECDH_C
        default y
    config MBEDTLS_ECP_C
        default y
    config MBEDTLS_ECP_DP_SECP256R1_ENABLED # there's also CONFIG_MBEDTLS_ECP_ALL_ENABLED
        default y
    config MBEDTLS_KEY_EXCHANGE_ECDHE_ECDSA_ENABLED # there's also CONFIG_MBEDTLS_KEY_EXCHANGE_ALL_ENABLED
        default y
    config MBEDTLS_CIPHER_GCM_ENABLED # there's also CONFIG_MBEDTLS_HASH_ALL_ENABLED
        default y
    config MBEDTLS_CIPHER_CCM_ENABLED
        default y
    config MBEDTLS_CIPHER_MODE_CBC_ENABLED
        default n
    config MBEDTLS_SSL_TLS1_3_KEY_EXCHANGE_MODE_EPHEMERAL_ENABLED
        bool
        default y
    config MBEDTLS_TLS_VERSION_1_3
        bool
        default y
    config MBEDTLS_PSA_CRYPTO_C
        default y
    config PSA_CRYPTO_ENABLE_ALL
        default y
    config MBEDTLS_HKDF_C
        default y
endif # AFB_ZEPHYR_MBEDTLS
```
